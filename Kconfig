## boards/shields/lily58_unified/Kconfig.defconfig
```kconfig
if SHIELD_LILY58_UNIFIED

config ZMK_KEYBOARD_NAME
    default "Lily58 Unified"

endif
```

## boards/shields/lily58_unified/Kconfig.shield
```kconfig
config SHIELD_LILY58_UNIFIED
    def_bool $(shields_list_contains,lily58_unified)
```
